## esp32/idf/esp-miot/sdkconfig.defaults.esp32s3
```kconfig
CONFIG_BLINK_LED_STRIP=y
#
# Please Note:
# ESP32-S3-DevKitC v1.1 uses GPIO38 for the on-board LED
# ESP32-S3-DevKitC v1.0 uses GPIO48 for the on-board LED
#
CONFIG_BLINK_GPIO=38

# Disable USB Serial JTAG for battery/external power operation
# Only use UART for console to avoid USB dependency issues
CONFIG_ESP_CONSOLE_UART_DEFAULT=y
CONFIG_ESP_CONSOLE_SECONDARY_NONE=y
```
